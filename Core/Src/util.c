#include "main.h"
#include "util.h"


static const unsigned aucCRCHi[] = {
	0x00, 0xC1, 0x81, 0x40, 0x01, 0xC0, 0x80, 0x41, 0x01, 0xC0, 0x80, 0x41,
	0x00, 0xC1, 0x81, 0x40, 0x01, 0xC0, 0x80, 0x41, 0x00, 0xC1, 0x81, 0x40,
	0x00, 0xC1, 0x81, 0x40, 0x01, 0xC0, 0x80, 0x41, 0x01, 0xC0, 0x80, 0x41,
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	0x00, 0xC1, 0x81, 0x40
};

static const unsigned aucCRCLo[] = {
	0x00, 0xC0, 0xC1, 0x01, 0xC3, 0x03, 0x02, 0xC2, 0xC6, 0x06, 0x07, 0xC7,
	0x05, 0xC5, 0xC4, 0x04, 0xCC, 0x0C, 0x0D, 0xCD, 0x0F, 0xCF, 0xCE, 0x0E,
	0x0A, 0xCA, 0xCB, 0x0B, 0xC9, 0x09, 0x08, 0xC8, 0xD8, 0x18, 0x19, 0xD9,
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	0x41, 0x81, 0x80, 0x40
};

uint16_t get_crc16(uint8_t *data, uint32_t len)
{
	uint8_t ucCRCHi = 0xFF;
	uint8_t ucCRCLo = 0xFF;
	uint16_t index = 0;
	int dataIndex = 0;

	while(len--)
	{
              index = ucCRCLo ^ data[dataIndex];
              ucCRCLo = (unsigned char)(ucCRCHi ^ aucCRCHi[index]);
              ucCRCHi = aucCRCLo[index];
              dataIndex++;
	}
	return (uint16_t)( ucCRCHi << 8 | ucCRCLo );
}


bool isEqualcrc16(uint16_t crc16,uint8_t crc_low,uint8_t crc_high)
{
    if(crc16==(crc_low|(crc_high<<8)))
    return TRUE;
    return FALSE;
}


void Rs485CreatePackage(uint8_t* dst,uint8_t id,uint8_t cmd,uint16_t status,uint8_t err)
{
	dst[0] = '#';
	dst[1] = (uint8_t)id;		
	dst[2] = cmd;
	memset(&dst[3],0,5);
	dst[8] = status;
	dst[9] = err;		
	dst[10] = ModbusCS_CalcForProtocol(dst,10);	
	dst[11] = '*'; 	
}


uint8_t ModbusCS_CalcForProtocol(uint8_t* dat,uint16_t len)
{
    uint16_t csData = 0;
	uint8_t csDataMod=0;

    
	while(len--)
	{
		csData   += *(dat++);
	}
	csDataMod = csData%256;
	return csDataMod;	
}

uint8_t ModbusCS_CalcNegForProtocol(uint8_t* dat,uint16_t len)
{
    uint16_t csData = 0;
	uint8_t csDataMod=0;

    
	while(len--)
	{
		csData += *(dat++);
	}
	csDataMod = csData%256;
	csDataMod = ~csDataMod;
	return csDataMod;	
}


uint8_t get_chk_bcc(uint8_t *dat, uint32_t len)
{
    uint8_t temp=0;
    for(uint8_t i=0;i<len;i++)
    {
        temp=dat[i]^temp;
    }
    return (temp);
}



uint8_t Rs485CheckHeadTailCS(uint8_t* dat,uint16_t len)
{
	if((dat[0] != '#')||(dat[len-1] != '*'))
	{
		return 0;
	}
	if(ModbusCS_CalcForProtocol(dat,(len-2)) != (dat[len-2]))
	{
		return 0;
	}
	return 1;
}

uint8_t GprsCheckHeadTailCRC16(uint8_t* dat,uint16_t len)
{
	uint16_t crc16;

    //header,tail
	if((dat[0] != '#')||(dat[1] != '#'))
	return 0;

	if((dat[len-1] != '*')||(dat[len-2] != '*'))
	return 0;

	crc16 = get_crc16(dat,(len-1));
	if(!isEqualcrc16(crc16,dat[len-3],dat[len-4]))  
	return 0; 	

	return 1;
}


uint32_t FourBytes2uint32BigEndian(uint8_t* dat)
{
	return (dat[0]<<24)+(dat[1]<<16)+(dat[2]<<8)+dat[3];
}

int32_t FourBytes2int32BigEndian(uint8_t* dat)
{
	return (dat[0]<<24)+(dat[1]<<16)+(dat[2]<<8)+dat[3];
}

uint32_t FourBytes2uint32LittleEndian(uint8_t* dat)
{
	return (dat[3]<<24)+(dat[2]<<16)+(dat[1]<<8)+dat[0];
}

int32_t FourBytes2int32LittleEndian(uint8_t* dat)
{
	return (dat[3]<<24)+(dat[2]<<16)+(dat[1]<<8)+dat[0];
}


uint32_t ThreeBytes2uint32BigEndian(uint8_t* dat)
{
	return (dat[0]<<16)+(dat[1]<<8)+dat[2];
}

int32_t ThreeBytes2int32BigEndian(uint8_t* dat)
{
	return (dat[0]<<16)+(dat[1]<<8)+dat[2];
}

uint32_t ThreeBytes2uint32LittleEndian(uint8_t* dat)
{
	return (dat[2]<<16)+(dat[1]<<8)+dat[0];
}

int32_t ThreeBytes2int32LittleEndian(uint8_t* dat)
{
	return (dat[2]<<16)+(dat[1]<<8)+dat[0];
}


uint16_t TwoBytes2uint16BigEndian(uint8_t* dat)
{
	return ((dat[0]<<8)+dat[1]);
}

int16_t TwoBytes2int16BigEndian(uint8_t* dat)
{
	return ((dat[0]<<8)+dat[1]);
}

uint16_t TwoBytes2uint16LittleEndian(uint8_t* dat)
{
	return ((dat[1]<<8)+dat[0]);
}

int16_t TwoBytes2int16LittleEndian(uint8_t* dat)
{
	return ((dat[1]<<8)+dat[0]);
}

void uint32ToFourBytesBigEndian(uint32_t dat,uint8_t* dst)
{
	*dst++ = (dat>>24);
	*dst++ = (dat>>16);
	*dst++ = (dat>>8);
	*dst = dat;
}


void uint32ToFourBytesLittleEndian(uint32_t dat,uint8_t* dst)
{
	*dst++ = dat;
	*dst++ = (dat>>8);
	*dst++ = (dat>>16);
	*dst = (dat>>24);
}

uint16_t  uartCreateRespDataPackage(uint8_t* sendBuffer,uint16_t frame,uint16_t cabinet_no,uint16_t Lock_Total_Nums,uint8_t cmd,uint8_t *dat,uint16_t len)
{
	uint16_t crc16;
    sendBuffer[0] = '#';
	sendBuffer[1] = '#';
	sendBuffer[2] = (uint8_t)(frame>>8);
	sendBuffer[3] = (uint8_t)frame;
	sendBuffer[4] = (uint8_t)(cabinet_no>>8);
	sendBuffer[5] = (uint8_t)cabinet_no;
	sendBuffer[6] = Lock_Total_Nums;
    sendBuffer[7] = cmd;
    sendBuffer[8] = (uint8_t)(len>>8);
    sendBuffer[9] = (uint8_t)(len);	
	memcpy(&sendBuffer[10],dat,len);

 	crc16 = get_crc16(sendBuffer,(10+len));	
	sendBuffer[10+len] = (uint8_t)(crc16>>8);
	sendBuffer[10+len+1] = (uint8_t)crc16;
    sendBuffer[10+len+2] = '*';
    sendBuffer[10+len+3] = '*';
	return (len+14);
}











